/**
 * @file ntc_temp_table.h
 * @brief NTC热敏电阻温度查表模块 
 *
 * 支持参数:
 *   - B3435: Rp=10K, B=3435, T25=10K, Vref=3.3V, 12-bit ADC
 *   - B3950: Rp=10K, B=3950, T25=10K, Vref=3.3V, 12-bit ADC
 *
 * 温度范围: -55.0°C ~ 200.0°C
 * 精度: 0.1°C
 *
 * 特性:
 *   - 双NTC参数支持 (B3435/B3950), 编译期选择或运行时切换
 *   - 上下拉电路拓扑支持
 *   - ADC多次采样均值滤波 + 一阶滑动滤波
 *   - 断线/短路故障检测
 *   - 查表 + 线性插值, 节省Flash (稀疏表)
 *   - STM32 DMA采集友好接口
 *
 * 使用方法:
 *   1. 选择NTC参数: #define NTC_USE_B3435 或 #define NTC_USE_B3950
 *   2. 选择电路拓扑: #define NTC_POSITION_LOWER 或 NTC_POSITION_UPPER
 *   3. 调用 NTC_Init() 初始化
 *   4. 喂入ADC原始值: NTC_FeedADC(adc_raw)
 *   5. 获取温度: NTC_GetTempX10() 返回温度*10
 */

#ifndef __NTC_TEMP_TABLE_H
#define __NTC_TEMP_TABLE_H

#ifdef __cplusplus
extern "C" {
#endif

#include <stdint.h>
#include <stdlib.h>  /* abs() */

/* ========================================================================== */
/*                              配置区                                         */
/* ========================================================================== */

/* 选择NTC B值参数 (二选一) */
#ifndef NTC_USE_B3950
#define NTC_USE_B3435
#endif
/* #define NTC_USE_B3950 */

/* 选择热敏电阻位置 (二选一) */
#define NTC_POSITION_LOWER   /* VCC---Rp(10K)---ADC---NTC---GND */
/* #define NTC_POSITION_UPPER */  /* VCC---NTC---ADC---Rp(10K)---GND */

/* ADC滤波配置 */
#define NTC_FILTER_SAMPLES   8     /* 多次采样取平均次数 (2的幂次) */
#define NTC_FILTER_SHIFT     3     /* log2(NTC_FILTER_SAMPLES) */
#define NTC_EMA_ALPHA_SHIFT  2     /* 一阶EMA滤波系数 alpha=1/(1<<shift), 越大越平滑 */

/* 故障检测阈值 */
#define NTC_ADC_SHORT_TH     5     /* ADC < 此值判断短路 */
#define NTC_ADC_OPEN_TH      4090  /* ADC > 此值判断断路 */

/* 温度范围 (×10) */
#define NTC_TEMP_MIN_X10     (-550)  /* -55.0°C */
#define NTC_TEMP_MAX_X10     (2000)  /* 200.0°C */
#define NTC_TEMP_ERR_X10     (0x7FFF) /* 错误标记值 */

/* ========================================================================== */
/*                          温度辅助宏                                         */
/* ========================================================================== */

#define TEMP_INT(t)   ((t) / 10)
#define TEMP_FRAC(t)  (((t) >= 0) ? ((t) % 10) : (-(t) % 10))
#define TEMP_SIGN(t)  (((t) >= 0) ? '+' : '-')

/* printf示例: printf("%c%d.%d°C", TEMP_SIGN(t), abs(TEMP_INT(t)), TEMP_FRAC(t)); */

/* ========================================================================== */
/*                        故障状态枚举                                         */
/* ========================================================================== */

typedef enum {
    NTC_OK         = 0,
    NTC_ERR_SHORT  = 1,   /* NTC短路 (ADC接近0或4095, 取决于拓扑) */
    NTC_ERR_OPEN   = 2,   /* NTC断路 */
    NTC_ERR_RANGE  = 3,   /* 温度超出范围 */
} NTC_Status_t;

/* ========================================================================== */
/*                     稀疏查找表 (每隔4个ADC点存一个值)                         */
/* ========================================================================== */

/*
 * 为节省Flash, 使用1/4稀疏率: 只存ADC=0,4,8,...,4092对应的温度值
 * 共 4096/4 = 1024 个元素, 占用 2KB Flash (比完整表8KB节省75%)
 * 中间值通过线性插值获得, 精度损失 < 0.05°C
 */
#define NTC_TABLE_STEP  4
#define NTC_TABLE_SIZE  (4096 / NTC_TABLE_STEP)  /* 1024 */

/* ---- B3435 查找表 ---- */
#ifdef NTC_USE_B3435

#ifdef NTC_POSITION_LOWER
static const int16_t ntc_sparse_table[NTC_TABLE_SIZE] = {
     2000,  2000,  2000,  2000,  2000,  2000,  2000,  2000,  2000,  2000,  2000,  2000,  2000,  2000,  2000,  1966,  /* ADC    0-  60 */
     1924,  1886,  1850,  1816,  1785,  1756,  1728,  1702,  1677,  1654,  1631,  1610,  1589,  1570,  1551,  1533,  /* ADC   64- 124 */
     1516,  1499,  1483,  1468,  1453,  1438,  1424,  1411,  1398,  1385,  1373,  1361,  1349,  1338,  1327,  1316,  /* ADC  128- 188 */
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     -541,  -550,  -550,  -550,  -550,  -550,  -550,  -550,  -550,  -550,  -550,  -550,  -550,  -550,  -550,  -550,  /* ADC 4032-4092 */
};
#else /* NTC_POSITION_UPPER */
static const int16_t ntc_sparse_table[NTC_TABLE_SIZE] = {
     -550,  -550,  -550,  -550,  -550,  -550,  -550,  -550,  -550,  -550,  -550,  -550,  -550,  -550,  -550,  -548,  /* ADC    0-  60 */
     -539,  -530,  -522,  -514,  -506,  -499,  -492,  -486,  -479,  -473,  -467,  -461,  -456,  -450,  -445,  -440,  /* ADC   64- 124 */
     -435,  -430,  -425,  -420,  -416,  -411,  -407,  -403,  -399,  -394,  -390,  -386,  -383,  -379,  -375,  -372,  /* ADC  128- 188 */
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     1934,  1977,  2000,  2000,  2000,  2000,  2000,  2000,  2000,  2000,  2000,  2000,  2000,  2000,  2000,  2000,  /* ADC 4032-4092 */
};
#endif

#endif /* NTC_USE_B3435 */

/* ---- B3950 查找表 ---- */
#ifdef NTC_USE_B3950

#ifdef NTC_POSITION_LOWER
static const int16_t ntc_sparse_table[NTC_TABLE_SIZE] = {
     2000,  2000,  2000,  2000,  2000,  2000,  2000,  2000,  1968,  1903,  1846,  1795,  1750,  1709,  1672,  1638,  /* ADC    0-  60 */
     1607,  1577,  1550,  1525,  1501,  1479,  1457,  1437,  1418,  1400,  1383,  1366,  1350,  1335,  1321,  1307,  /* ADC   64- 124 */
     1293,  1280,  1268,  1255,  1244,  1232,  1221,  1211,  1200,  1190,  1181,  1171,  1162,  1153,  1144,  1136,  /* ADC  128- 188 */
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     -462,  -471,  -480,  -490,  -500,  -512,  -524,  -537,  -550,  -550,  -550,  -550,  -550,  -550,  -550,  -550,  /* ADC 4032-4092 */
};
#else /* NTC_POSITION_UPPER */
static const int16_t ntc_sparse_table[NTC_TABLE_SIZE] = {
     -550,  -550,  -550,  -550,  -550,  -550,  -550,  -550,  -548,  -534,  -521,  -509,  -498,  -487,  -478,  -469,  /* ADC    0-  60 */
     -460,  -452,  -444,  -437,  -430,  -423,  -417,  -411,  -405,  -399,  -394,  -388,  -383,  -378,  -373,  -368,  /* ADC   64- 124 */
     -364,  -359,  -355,  -350,  -346,  -342,  -338,  -334,  -330,  -327,  -323,  -319,  -316,  -312,  -309,  -306,  /* ADC  128- 188 */
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     1614,  1646,  1681,  1719,  1761,  1807,  1859,  1918,  1986,  2000,  2000,  2000,  2000,  2000,  2000,  2000,  /* ADC 4032-4092 */
};
#endif

#endif /* NTC_USE_B3950 */

/* ========================================================================== */
/*               运行时切换表 (可选, 需定义 NTC_RUNTIME_SELECT)                 */
/* ========================================================================== */

#ifdef NTC_RUNTIME_SELECT

#ifdef NTC_POSITION_LOWER
static const int16_t ntc_table_b3435[NTC_TABLE_SIZE] = {
     2000,  2000,  2000,  2000,  2000,  2000,  2000,  2000,  2000,  2000,  2000,  2000,  2000,  2000,  2000,  1966,  /* ADC    0-  60 */
     1924,  1886,  1850,  1816,  1785,  1756,  1728,  1702,  1677,  1654,  1631,  1610,  1589,  1570,  1551,  1533,  /* ADC   64- 124 */
     1516,  1499,  1483,  1468,  1453,  1438,  1424,  1411,  1398,  1385,  1373,  1361,  1349,  1338,  1327,  1316,  /* ADC  128- 188 */
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     -541,  -550,  -550,  -550,  -550,  -550,  -550,  -550,  -550,  -550,  -550,  -550,  -550,  -550,  -550,  -550,  /* ADC 4032-4092 */
};
static const int16_t ntc_table_b3950[NTC_TABLE_SIZE] = {
     2000,  2000,  2000,  2000,  2000,  2000,  2000,  2000,  1968,  1903,  1846,  1795,  1750,  1709,  1672,  1638,  /* ADC    0-  60 */
     1607,  1577,  1550,  1525,  1501,  1479,  1457,  1437,  1418,  1400,  1383,  1366,  1350,  1335,  1321,  1307,  /* ADC   64- 124 */
     1293,  1280,  1268,  1255,  1244,  1232,  1221,  1211,  1200,  1190,  1181,  1171,  1162,  1153,  1144,  1136,  /* ADC  128- 188 */
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     -462,  -471,  -480,  -490,  -500,  -512,  -524,  -537,  -550,  -550,  -550,  -550,  -550,  -550,  -550,  -550,  /* ADC 4032-4092 */
};
#else /* NTC_POSITION_UPPER */
static const int16_t ntc_table_b3435[NTC_TABLE_SIZE] = {
     -550,  -550,  -550,  -550,  -550,  -550,  -550,  -550,  -550,  -550,  -550,  -550,  -550,  -550,  -550,  -548,  /* ADC    0-  60 */
     -539,  -530,  -522,  -514,  -506,  -499,  -492,  -486,  -479,  -473,  -467,  -461,  -456,  -450,  -445,  -440,  /* ADC   64- 124 */
     -435,  -430,  -425,  -420,  -416,  -411,  -407,  -403,  -399,  -394,  -390,  -386,  -383,  -379,  -375,  -372,  /* ADC  128- 188 */
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     1934,  1977,  2000,  2000,  2000,  2000,  2000,  2000,  2000,  2000,  2000,  2000,  2000,  2000,  2000,  2000,  /* ADC 4032-4092 */
};
static const int16_t ntc_table_b3950[NTC_TABLE_SIZE] = {
     -550,  -550,  -550,  -550,  -550,  -550,  -550,  -550,  -548,  -534,  -521,  -509,  -498,  -487,  -478,  -469,  /* ADC    0-  60 */
     -460,  -452,  -444,  -437,  -430,  -423,  -417,  -411,  -405,  -399,  -394,  -388,  -383,  -378,  -373,  -368,  /* ADC   64- 124 */
     -364,  -359,  -355,  -350,  -346,  -342,  -338,  -334,  -330,  -327,  -323,  -319,  -316,  -312,  -309,  -306,  /* ADC  128- 188 */
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     1614,  1646,  1681,  1719,  1761,  1807,  1859,  1918,  1986,  2000,  2000,  2000,  2000,  2000,  2000,  2000,  /* ADC 4032-4092 */
};
#endif

typedef enum {
    NTC_PARAM_B3435 = 0,
    NTC_PARAM_B3950 = 1,
} NTC_Param_t;

static const int16_t *ntc_runtime_tables[] = {
    ntc_table_b3435,
    ntc_table_b3950,
};

#endif /* NTC_RUNTIME_SELECT */

/* ========================================================================== */
/*                          核心算法实现                                        */
/* ========================================================================== */

/**
 * @brief 稀疏表 + 线性插值查温度
 * @param adc_val: 12-bit ADC值 (0~4095)
 * @param table: 稀疏查找表指针 (可用于运行时切换)
 * @return 温度值×10
 */
static inline int16_t NTC_LookupInterp(uint16_t adc_val, const int16_t *table)
{
    if (adc_val > 4095u) adc_val = 4095u;

    uint16_t idx = adc_val >> 2;           /* adc_val / 4 */
    uint16_t frac = adc_val & 0x03u;       /* adc_val % 4 */

    if (idx >= (NTC_TABLE_SIZE - 1u)) {
        return table[NTC_TABLE_SIZE - 1u];
    }

    if (frac == 0u) {
        return table[idx];
    }

    /* 线性插值: t = t0 + (t1 - t0) * frac / 4 */
    int16_t t0 = table[idx];
    int16_t t1 = table[idx + 1u];
    return (int16_t)(t0 + (((int32_t)(t1 - t0) * frac + 2) >> 2));
}

/* ========================================================================== */
/*                      NTC控制结构体 & 滤波器                                  */
/* ========================================================================== */

typedef struct {
    /* 滤波状态 */
    uint32_t sum;              /* 多次采样累加 */
    uint8_t  sample_cnt;       /* 当前采样计数 */
    int32_t  ema_val;          /* EMA滤波值 (×16 定点) */
    uint8_t  ema_inited;       /* EMA是否已初始化 */

    /* 输出 */
    int16_t  temp_x10;         /* 最终温度值×10 */
    NTC_Status_t status;       /* 故障状态 */

#ifdef NTC_RUNTIME_SELECT
    const int16_t *table;      /* 运行时选择的表 */
#endif
} NTC_Handle_t;

/**
 * @brief 初始化NTC句柄
 */
static inline void NTC_Init(NTC_Handle_t *h)
{
    h->sum = 0;
    h->sample_cnt = 0;
    h->ema_val = 0;
    h->ema_inited = 0;
    h->temp_x10 = 0;
    h->status = NTC_OK;
#ifdef NTC_RUNTIME_SELECT
    h->table = ntc_table_b3435;  /* 默认B3435 */
#endif
}

#ifdef NTC_RUNTIME_SELECT
/**
 * @brief 运行时切换NTC参数
 */
static inline void NTC_SetParam(NTC_Handle_t *h, NTC_Param_t param)
{
    h->table = ntc_runtime_tables[param];
    h->ema_inited = 0;  /* 切换后重置滤波器 */
}
#endif

/**
 * @brief 喂入一个ADC原始值, 内部自动滤波
 * @param h: NTC句柄
 * @param adc_raw: 12-bit ADC原始值
 * @return 当一轮采样完成时返回1, 否则返回0
 *
 * 典型用法 (在ADC中断或DMA回调中):
 *   if (NTC_FeedADC(&ntc, adc_val)) {
 *       int16_t temp = NTC_GetTempX10(&ntc);
 *   }
 */
static inline uint8_t NTC_FeedADC(NTC_Handle_t *h, uint16_t adc_raw)
{
    h->sum += adc_raw;
    h->sample_cnt++;

    if (h->sample_cnt < NTC_FILTER_SAMPLES) {
        return 0;
    }

    /* 多次采样均值 */
    uint16_t adc_avg = (uint16_t)(h->sum >> NTC_FILTER_SHIFT);
    h->sum = 0;
    h->sample_cnt = 0;

    /* 故障检测 */
#ifdef NTC_POSITION_LOWER
    /* 下拉: ADC≈0 -> NTC短路(R→0), ADC≈4095 -> NTC断路(R→∞) */
    if (adc_avg < NTC_ADC_SHORT_TH) { h->status = NTC_ERR_SHORT; h->temp_x10 = NTC_TEMP_ERR_X10; return 1; }
    if (adc_avg > NTC_ADC_OPEN_TH)  { h->status = NTC_ERR_OPEN;  h->temp_x10 = NTC_TEMP_ERR_X10; return 1; }
#else
    /* 上拉: ADC≈4095 -> NTC短路, ADC≈0 -> NTC断路 */
    if (adc_avg > NTC_ADC_OPEN_TH)  { h->status = NTC_ERR_SHORT; h->temp_x10 = NTC_TEMP_ERR_X10; return 1; }
    if (adc_avg < NTC_ADC_SHORT_TH) { h->status = NTC_ERR_OPEN;  h->temp_x10 = NTC_TEMP_ERR_X10; return 1; }
#endif

    /* EMA一阶滤波 (定点: ema_val放大16倍) */
    int32_t adc_fp = (int32_t)adc_avg << 4;
    if (!h->ema_inited) {
        h->ema_val = adc_fp;
        h->ema_inited = 1;
    } else {
        /* ema = ema + (new - ema) >> alpha_shift */
        h->ema_val += (adc_fp - h->ema_val) >> NTC_EMA_ALPHA_SHIFT;
    }
    uint16_t adc_filtered = (uint16_t)((h->ema_val + 8) >> 4);

    /* 查表 + 插值 */
#ifdef NTC_RUNTIME_SELECT
    h->temp_x10 = NTC_LookupInterp(adc_filtered, h->table);
#else
    h->temp_x10 = NTC_LookupInterp(adc_filtered, ntc_sparse_table);
#endif

    h->status = NTC_OK;
    return 1;
}

/**
 * @brief 获取当前温度 (×10)
 */
static inline int16_t NTC_GetTempX10(const NTC_Handle_t *h)
{
    return h->temp_x10;
}

/**
 * @brief 获取浮点温度
 */
static inline float NTC_GetTempFloat(const NTC_Handle_t *h)
{
    return h->temp_x10 / 10.0f;
}

/**
 * @brief 获取故障状态
 */
static inline NTC_Status_t NTC_GetStatus(const NTC_Handle_t *h)
{
    return h->status;
}

/**
 * @brief 简易接口 - 直接ADC转温度 (无滤波, 兼容旧接口)
 */
static inline int16_t Temp_transition(uint16_t adc_data)
{
#ifdef NTC_RUNTIME_SELECT
    return NTC_LookupInterp(adc_data, ntc_table_b3435);
#else
    return NTC_LookupInterp(adc_data, ntc_sparse_table);
#endif
}

static inline int16_t Temp_transition_int(uint16_t adc_data)
{
    return Temp_transition(adc_data) / 10;
}

static inline float Temp_transition_float(uint16_t adc_data)
{
    return Temp_transition(adc_data) / 10.0f;
}

/* ========================================================================== */
/*                 带符号正码表示法 (Sign-Magnitude Encoding)                    */
/* ========================================================================== */
/*
 * 编码格式 (uint16_t):
 *   bit[15]   = 符号位: 0=正温度, 1=负温度
 *   bit[14:0] = 温度绝对值 (单位: 0.1°C)
 *
 * 示例:
 *   +25.0°C -> temp_x10=250  -> 0x00FA
 *   -40.0°C -> temp_x10=-400 -> 0x8190  (0x8000 | 400)
 *    +0.0°C -> temp_x10=0    -> 0x0000
 *   -55.0°C -> temp_x10=-550 -> 0x8226  (0x8000 | 550)
 *  +200.0°C -> temp_x10=2000 -> 0x07D0
 */

#define NTC_SIGN_BIT      0x8000u
#define NTC_MAG_MASK      0x7FFFu

/**
 * @brief temp_x10 -> 带符号正码
 */
static inline uint16_t NTC_TempToCode(int16_t temp_x10)
{
    if (temp_x10 >= 0) {
        return (uint16_t)temp_x10;
    }
    return (uint16_t)(NTC_SIGN_BIT | (uint16_t)(-temp_x10));
}

/**
 * @brief 带符号正码 -> temp_x10
 */
static inline int16_t NTC_CodeToTemp(uint16_t code)
{
    if (code & NTC_SIGN_BIT) {
        return -(int16_t)(code & NTC_MAG_MASK);
    }
    return (int16_t)code;
}

/**
 * @brief ADC直接转带符号正码
 */
static inline uint16_t Temp_transition_code(uint16_t adc_data)
{
    return NTC_TempToCode(Temp_transition(adc_data));
}

/**
 * @brief 从NTC句柄获取带符号正码
 */
static inline uint16_t NTC_GetTempCode(const NTC_Handle_t *h)
{
    return NTC_TempToCode(h->temp_x10);
}

/**
 * @brief 批量ADC转带符号正码
 */
static inline void NTC_BatchConvertCode(const uint16_t *adc_buf, uint16_t *code_buf,
                                         uint16_t len, const int16_t *table)
{
    for (uint16_t i = 0; i < len; i++) {
        code_buf[i] = NTC_TempToCode(NTC_LookupInterp(adc_buf[i], table));
    }
}

/* ========================================================================== */
/*                      DMA批量转换辅助函数                                     */
/* ========================================================================== */

/**
 * @brief 批量ADC转温度 (适用于DMA采集后一次性转换)
 * @param adc_buf: ADC数据缓冲区
 * @param temp_buf: 温度输出缓冲区 (×10)
 * @param len: 数据长度
 * @param table: 查找表指针
 */
static inline void NTC_BatchConvert(const uint16_t *adc_buf, int16_t *temp_buf,
                                     uint16_t len, const int16_t *table)
{
    for (uint16_t i = 0; i < len; i++) {
        temp_buf[i] = NTC_LookupInterp(adc_buf[i], table);
    }
}

#ifdef __cplusplus
}
#endif

#endif /* __NTC_TEMP_TABLE_H */
